## main/Kconfig.projbuild
```kconfig
menu "Example Configuration"
    choice
        prompt "Select the example to build"
        default EXAMPLE_BUILD_SCREEN_LVGL
        config EXAMPLE_BUILD_HAPTIC_FEEDBACK
            bool "haptic_feedback"
            depends on LILYGO_DEVICE_DRIVER_T_DISPLAY_P4 || LILYGO_DEVICE_DRIVER_T_DISPLAY_P4_AIR
        config EXAMPLE_BUILD_IMU
            bool "imu"
            depends on LILYGO_DEVICE_DRIVER_T_DISPLAY_P4 || LILYGO_DEVICE_DRIVER_T_DISPLAY_P4_AIR
        config EXAMPLE_BUILD_GPS
            bool "gps"
            depends on LILYGO_DEVICE_DRIVER_T_DISPLAY_P4 || LILYGO_DEVICE_DRIVER_T_DISPLAY_P4_AIR
        config EXAMPLE_BUILD_LORA_TX_RX
            bool "lora_tx_rx"
            depends on LILYGO_DEVICE_DRIVER_T_DISPLAY_P4 || LILYGO_DEVICE_DRIVER_T_DISPLAY_P4_AIR
        config EXAMPLE_BUILD_LORA_RX_SENSITIVITY
            bool "lora_rx_sensitivity"
            depends on LILYGO_DEVICE_DRIVER_T_DISPLAY_P4 || LILYGO_DEVICE_DRIVER_T_DISPLAY_P4_AIR
        config EXAMPLE_BUILD_GFSK_TX_RX
            bool "gfsk_tx_rx"
            depends on LILYGO_DEVICE_DRIVER_T_DISPLAY_P4
        config EXAMPLE_BUILD_ENHANCED_SHOCKBURST_TX_RX
            bool "enhanced_shockburst_tx_rx"
            depends on LILYGO_DEVICE_DRIVER_T_DISPLAY_P4
        config EXAMPLE_BUILD_RTC
            bool "rtc"
            depends on LILYGO_DEVICE_DRIVER_T_DISPLAY_P4
        config EXAMPLE_BUILD_BATTERY_MANAGEMENT
            bool "battery_management"
            depends on LILYGO_DEVICE_DRIVER_T_DISPLAY_P4 || LILYGO_DEVICE_DRIVER_T_DISPLAY_P4_AIR
        config EXAMPLE_BUILD_MICROPHONE_SPEAKER_LOOPBACK
            bool "microphone_speaker_loopback"
            depends on LILYGO_DEVICE_DRIVER_T_DISPLAY_P4 || LILYGO_DEVICE_DRIVER_T_DISPLAY_P4_AIR
        config EXAMPLE_BUILD_SD_MP3
            bool "sd_mp3"
            depends on LILYGO_DEVICE_DRIVER_T_DISPLAY_P4 || LILYGO_DEVICE_DRIVER_T_DISPLAY_P4_AIR || LILYGO_DEVICE_DRIVER_T_GLASSES_P4
        config EXAMPLE_BUILD_WIFI_MP3
            bool "wifi_mp3"
            depends on LILYGO_DEVICE_DRIVER_T_DISPLAY_P4 || LILYGO_DEVICE_DRIVER_T_DISPLAY_P4_AIR
            select MBEDTLS_CERTIFICATE_BUNDLE
        config EXAMPLE_BUILD_WIFI_SCAN_CONNECT_TIME
            bool "wifi_scan_connect_time"
            depends on LILYGO_DEVICE_DRIVER_T_DISPLAY_P4 || LILYGO_DEVICE_DRIVER_T_DISPLAY_P4_AIR
        config EXAMPLE_BUILD_COPROCESSOR_DOWNLOAD_MODE
            bool "coprocessor_download_mode"
            depends on LILYGO_DEVICE_DRIVER_T_DISPLAY_P4 || LILYGO_DEVICE_DRIVER_T_DISPLAY_P4_AIR
        config EXAMPLE_BUILD_NETWORK_ADAPTER_UPDATE
            bool "network_adapter_update"
            depends on LILYGO_DEVICE_DRIVER_T_DISPLAY_P4
        config EXAMPLE_BUILD_OTA_UPDATE
            bool "ota_update"
            depends on LILYGO_DEVICE_DRIVER_T_DISPLAY_P4 || LILYGO_DEVICE_DRIVER_T_DISPLAY_P4_AIR
            select MBEDTLS_CERTIFICATE_BUNDLE
        config EXAMPLE_BUILD_I2C_SCAN
            bool "i2c_scan"
            depends on LILYGO_DEVICE_DRIVER_T_DISPLAY_P4 || LILYGO_DEVICE_DRIVER_T_DISPLAY_P4_AIR
        config EXAMPLE_BUILD_SCREEN_CAMERA
            bool "screen_camera"
            depends on LILYGO_DEVICE_DRIVER_T_DISPLAY_P4 || LILYGO_DEVICE_DRIVER_T_DISPLAY_P4_AIR || LILYGO_DEVICE_DRIVER_T_GLASSES_P4
        config EXAMPLE_BUILD_SCREEN_LVGL
            bool "screen_lvgl"
            depends on LILYGO_DEVICE_DRIVER_T_DISPLAY_P4 || LILYGO_DEVICE_DRIVER_T_DISPLAY_P4_AIR || LILYGO_DEVICE_DRIVER_T_GLASSES_P4
        config EXAMPLE_BUILD_SCREEN_LVGL_TOUCH_DRAW
            bool "screen_lvgl_touch_draw"
            depends on LILYGO_DEVICE_DRIVER_T_DISPLAY_P4 || LILYGO_DEVICE_DRIVER_T_DISPLAY_P4_AIR
        config EXAMPLE_BUILD_SGM38121
            bool "sgm38121"
            depends on LILYGO_DEVICE_DRIVER_T_DISPLAY_P4 || LILYGO_DEVICE_DRIVER_T_DISPLAY_P4_AIR
        config EXAMPLE_BUILD_ST25R3916
            bool "st25r3916"
            depends on LILYGO_DEVICE_DRIVER_T_DISPLAY_P4 || LILYGO_DEVICE_DRIVER_T_DISPLAY_P4_AIR
        config EXAMPLE_BUILD_SLEEP
            bool "sleep"
            depends on LILYGO_DEVICE_DRIVER_T_DISPLAY_P4 || LILYGO_DEVICE_DRIVER_T_DISPLAY_P4_AIR
        config EXAMPLE_BUILD_TCA8418
            bool "tca8418"
            depends on LILYGO_DEVICE_DRIVER_T_DISPLAY_P4
        config EXAMPLE_BUILD_XL95X5
            bool "xl95x5"
            depends on LILYGO_DEVICE_DRIVER_T_DISPLAY_P4 || LILYGO_DEVICE_DRIVER_T_DISPLAY_P4_AIR
    endchoice

endmenu
```

## sdkconfig.defaults.esp32p4
```kconfig
CONFIG_ESPTOOLPY_FLASHSIZE_16MB=y
CONFIG_PARTITION_TABLE_CUSTOM=y
CONFIG_PARTITION_TABLE_CUSTOM_FILENAME="partitions_esp32p4.csv"

CONFIG_SPIRAM=y
CONFIG_SPIRAM_MODE_HEX=y
CONFIG_SPIRAM_SPEED_200M=y

CONFIG_CACHE_L2_CACHE_256KB=y
CONFIG_CACHE_L2_CACHE_LINE_128B=y

CONFIG_VFS_MAX_COUNT=16

CONFIG_ESP_WIFI_NVS_ENABLED=n
CONFIG_ESP_HOSTED_AUTO_INIT=n

# RTL8152B 通过 USB CDC 通知报告真实链路状态。
CONFIG_ECM_AUTO_LINK_UP_AFTER_NO_NOTIFICATION=n
CONFIG_ECM_DISABLE_CDC_NOTIFICATION=n

CONFIG_CAMERA_SC2336=y
CONFIG_CAMERA_SC2336_MIPI_RAW8_1280x720_30FPS=n
CONFIG_CAMERA_SC2336_MIPI_RAW10_1280x720_30FPS=y

CONFIG_CAMERA_OV2710=y
CONFIG_CAMERA_OV2710_MIPI_RAW10_1280X720_25FPS=y
CONFIG_CAMERA_OV2710_MIPI_RAW10_1920X1080_25FPS=n

CONFIG_CAMERA_OV5645=y
CONFIG_CAMERA_OV5645_MIPI_RGB565_1280X960_30FPS=y
CONFIG_CAMERA_OV5645_MIPI_YUV422_1280X960_30FPS=n
```
